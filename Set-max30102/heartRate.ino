#include "Wire.h"           //  Подключаем библиотеку для работы с шиной I2C
#include "MAX30105.h"       //  Подключаем библиотеку для работы с модулем
#include "heartRate.h"      //  Подключаем блок для работы с ЧСС (пульс)
MAX30105 PARTICLE_SENSOR;   //  Создаём объект для работы с библиотекой
//--------------------------//
const byte RATE_SIZE = 4;   //  Коэффициент усреднения. ЧЕм больше число, тем больше усреднение показаний.
byte rates[RATE_SIZE];      //  Массив со значениями ЧСС
byte rateSpot = 0;          //  Переменная с порядковым номером значения в массиве
long lastBeat = 0;          //  Время последнего зафиксированного удара
float beatsPerMinute;       //  Создаём переменную для хранения значения ЧСС
int beatAvg;                //  Создаём переменную для хранения усреднённого значения ЧСС
//----------------------------------------------------//
void setup() {
  Serial.begin(115200);                               //  Инициируем работу с монитором последовательного порта на скорости 115200 бод
  if (!PARTICLE_SENSOR.begin()) {                     //  Инициируем работу с модулем. Если инициализация не прошла, то
    Serial.println("MAX30105 was not found");         //  выводим сообщение об этом в монитор последовательного порта
    while (1);                                        //  и останавливаем дальнейшее выполнение скетча
  }
  Serial.println("Place your finger on the sensor");  //  выводим сообщение "Положите палец сверху на сенсор"
  PARTICLE_SENSOR.setup();                            //  Устанавливаем настройки для сенсора по умолчанию
  PARTICLE_SENSOR.setPulseAmplitudeRed(0x0A);         //  Выключаем КРАСНЫЙ светодиод для того, чтобы модуль начал работу
  PARTICLE_SENSOR.setPulseAmplitudeGreen(0);          //  Выключаем ЗЕЛЁНЫЙ светодиод
}
//------------------------------------------------------//
void loop() {
  long irValue = PARTICLE_SENSOR.getIR();               //  Считываем значение отражённого ИК-светодиода (отвечающего за пульс) и
  if (checkForBeat(irValue) == true) {                  //  если пульс был зафиксирован, то
    long delta = millis() - lastBeat;                   //  находим дельту по времени между ударами
    lastBeat = millis();                                //  Обновляем счётчик
    beatsPerMinute = 60 / (delta / 1000.0);             //  Вычисляем количество ударов в минуту
    if (beatsPerMinute < 255 && beatsPerMinute > 20) {  //  Если количество ударов в минуту находится в промежутке между 20 и 255, то
      rates[rateSpot++] = (byte)beatsPerMinute;         //  записываем это значение в массив значений ЧСС
      rateSpot %= RATE_SIZE;                            //  Задаём порядковый номер значения в массиве, возвращая остаток от деления и присваивая его переменной rateSpot
      beatAvg = 0;                                      //  Обнуляем переменную и
      for (byte x = 0 ; x < RATE_SIZE ; x++) {          //  в цикле выполняем усреднение значений (чем больше RATE_SIZE, тем сильнее усреднение)
        beatAvg += rates[x];                            //  путём сложения всех элементов массива
      }
      beatAvg /= RATE_SIZE;                             //  а затем деления всей суммы на коэффициент усреднения (на общее количество элементов в массиве)
    }
  }
  Serial.print("IR=");                                  //  Выводим в монитор последовательного порта текст про значение ИК-светдиода
  Serial.print(irValue);                                //  Выводим в монитор последовательного порта значение с ИК-светодиода
  Serial.print(", BPM=");                               //  Выводим в монитор последовательного порта текст про значение ЧСС
  Serial.print(beatsPerMinute);                         //  Выводим в монитор последовательного порта значение ЧСС
  Serial.print(", Avg BPM=");                           //  Выводим в монитор последовательного порта текст про усреднённую ЧСС
  Serial.print(beatAvg);                                //  Выводим в монитор последовательного порта значение усреднённой ЧСС
  if (irValue < 50000)  Serial.print(" No finger?");    //  Если значение ИК-светодиода меньше указанного, то выводим текст о том, что палец убран с датчика
  Serial.println();                                     //  Выводим в монитор последовательного порта переход на новую строку
}